## uc/buttonsMeshIDF/sdkconfig.defaults
```kconfig
# Compiler optimization for size
CONFIG_COMPILER_OPTIMIZATION_SIZE=y
# Note: Assertions are kept enabled for safety. Disable for production with:
# CONFIG_COMPILER_OPTIMIZATION_ASSERTIONS_DISABLE=y

# ESP-WIFI-MESH configuration
CONFIG_ESP_WIFI_MESH_ENABLE=y
CONFIG_MESH_ROUTE_TABLE_SIZE=50
CONFIG_MESH_IE_CRYPTO_FUNCS=y

# WiFi configuration - Reduced to prevent memory exhaustion during mesh init
CONFIG_ESP_WIFI_STATIC_RX_BUFFER_NUM=10
CONFIG_ESP_WIFI_DYNAMIC_RX_BUFFER_NUM=16
CONFIG_ESP_WIFI_DYNAMIC_TX_BUFFER_NUM=16
CONFIG_ESP_WIFI_AMPDU_TX_ENABLED=y
CONFIG_ESP_WIFI_AMPDU_RX_ENABLED=y
CONFIG_ESP_WIFI_AMSDU_TX_ENABLED=n

# LWIP configuration
CONFIG_LWIP_MAX_SOCKETS=16
CONFIG_LWIP_SO_REUSE=y
CONFIG_LWIP_SO_RCVBUF=y

# FreeRTOS
CONFIG_FREERTOS_HZ=1000
CONFIG_FREERTOS_WATCHPOINT_END_OF_STACK=y

# Task WDT - Increased for mesh initialization
CONFIG_ESP_TASK_WDT_INIT=y
CONFIG_ESP_TASK_WDT_TIMEOUT_S=15

# Interrupt WDT - Increased for mesh initialization
CONFIG_ESP_INT_WDT_TIMEOUT_MS=800

# Debug settings
CONFIG_LOG_DEFAULT_LEVEL_INFO=y
CONFIG_LOG_MAXIMUM_LEVEL_VERBOSE=y

# Partition table
CONFIG_PARTITION_TABLE_CUSTOM=y
CONFIG_PARTITION_TABLE_CUSTOM_FILENAME="partitions.csv"
```
